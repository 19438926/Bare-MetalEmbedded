# file: NeoPixel.ioc
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Mcu.Family=STM32F4
Mcu.Name=STM32F429ZITx
Mcu.Package=LQFP144
NVIC.PriorityGroup=NVIC_PRIORITYGROUP_4
PA7.GPIO_Label=NeoPixel_Pin
PA7.Signal=GPIO_Output
ProjectManager.HeapSize=0x200
ProjectManager.StackSize=0x400
ProjectManager.TargetToolchain=STM32CubeIDE
RCC.48MHZClocksFreq_Value=90000000
RCC.AHBFreq_Value=180000000
RCC.APB1CLKDivider=RCC_HCLK_DIV4
RCC.APB1Freq_Value=45000000
RCC.APB1TimFreq_Value=90000000
RCC.APB2CLKDivider=RCC_HCLK_DIV2
RCC.APB2Freq_Value=90000000
RCC.APB2TimFreq_Value=180000000
RCC.CortexFreq_Value=180000000
RCC.HCLKFreq_Value=180000000
RCC.HSE_VALUE=25000000
RCC.HSI_VALUE=16000000
RCC.LSE_VALUE=32768
RCC.PLLM=8
RCC.PLLN=180
RCC.SYSCLKFreq_VALUE=180000000
RCC.SYSCLKSource=RCC_SYSCLKSOURCE_PLLCLK
RCC.VCOOutputFreq_Value=360000000
board=custom

// file: Core/Src/main.c
/* USER CODE BEGIN Header */
/**
  ******************************************************************************
  * @file           : main.c
  * @brief          : Main program body
  ******************************************************************************
  * @attention
  *
  * Copyright (c) 2026 STMicroelectronics.
  * All rights reserved.
  *
  * This software is licensed under terms that can be found in the LICENSE file
  * in the root directory of this software component.
  * If no LICENSE file comes with this software, it is provided AS-IS.
  *
  ******************************************************************************
  */
/* USER CODE END Header */
#include "main.h"

/* USER CODE BEGIN Includes */
#include "NeoPixel.h"

/* USER CODE END Includes */

/* USER CODE BEGIN PD */
#define ONE_HIGH      __asm__ volatile("nop\nnop\nnop\nnop\nnop\nnop\nnop\nnop\nnop\nnop\nnop\nnop\nnop\nnop\nnop\nnop\nnop\nnop\nnop\nnop\nnop\nnop\nnop\nnop\nnop\nnop\nnop\nnop\n");
#define ONE_LOW		  __asm__ volatile("nop\nnop\nnop\nnop\nnop\nnop\nnop\nnop\nnop\nnop\nnop\n");

/* USER CODE END PD */

/* USER CODE BEGIN PV */
// Color structures
const WS2812_LED LED_COLOR_BLACK    = RGB_COLOR_BLACK;
const WS2812_LED LED_COLOR_GRAY     = RGB_COLOR_GRAY;
const WS2812_LED LED_COLOR_WHITE    = RGB_COLOR_WHITE;
const WS2812_LED LED_COLOR_RED      = RGB_COLOR_RED;
const WS2812_LED LED_COLOR_GREEN    = RGB_COLOR_GREEN;
const WS2812_LED LED_COLOR_BLUE     = RGB_COLOR_BLUE;
const WS2812_LED LED_COLOR_ORANGE   = RGB_COLOR_ORANGE;
const WS2812_LED LED_COLOR_YELLOW   = RGB_COLOR_YELLOW;
const WS2812_LED LED_COLOR_VIOLET   = RGB_COLOR_VIOLET;
const WS2812_LED LED_COLOR_INDIGO   = RGB_COLOR_INDIGO;
const WS2812_LED LED_COLOR_CYAN     = RGB_COLOR_CYAN;
const WS2812_LED LED_COLOR_MAGENTA  = RGB_COLOR_MAGENTA;
const WS2812_LED LED_COLOR_AQUA     = RGB_COLOR_AQUA;

WS2812_LED logicLEDS[6] = {
                                     LED_COLOR_BLACK,
                                     LED_COLOR_BLACK,
                                     LED_COLOR_BLACK,
                                     LED_COLOR_BLACK,
                                     LED_COLOR_BLACK,
                                     LED_COLOR_BLACK
                                   };
WS2812_LED logicLEDS2[6] = {
                                     LED_COLOR_RED,
									 LED_COLOR_GREEN,
									 LED_COLOR_BLUE,
									 LED_COLOR_YELLOW,
									 LED_COLOR_CYAN,
									 LED_COLOR_VIOLET
                                   };

/* USER CODE END PV */

void SystemClock_Config(void);
static void MX_GPIO_Init(void);

int main(void)
{

  /* MCU Configuration--------------------------------------------------------*/

  /* Reset of all peripherals, Initializes the Flash interface and the Systick. */
  HAL_Init();

  /* Configure the system clock */
  SystemClock_Config();

  /* Initialize all configured peripherals */
  MX_GPIO_Init();
  /* USER CODE BEGIN 2 */
  WS2812_Reset();

  /* USER CODE END 2 */

  /* Infinite loop */
  while (1)
  {

    /* USER CODE BEGIN 3 */
	  WS2812_LED logicLEDS3[6];
	  for(int i = 0 ;i<6 ;i++)
	  {
		  WS2812_WriteLeds(logicLEDS, 6);
		  HAL_Delay(300);
		  for(int j = 0 ;j<6;j++)
		  {
			  logicLEDS3[j] = logicLEDS2[i];
		  }
		  for(int j = 1 ;j<7;j++)
		  {
			  WS2812_WriteLeds(logicLEDS3, j);
			  HAL_Delay(100);
		  }
		  for(int k = 6 ;k>0 ;k--)
		  {
			  WS2812_WriteLeds(logicLEDS3, k);
			  HAL_Delay(100);
			  WS2812_WriteLeds(logicLEDS, 6);
			  WS2812_Reset();
		  }
	  }
  }
  /* USER CODE END 3 */
}

void SystemClock_Config(void)
{
  RCC_OscInitTypeDef RCC_OscInitStruct = {0};
  RCC_ClkInitTypeDef RCC_ClkInitStruct = {0};

  /** Configure the main internal regulator output voltage
  */
  __HAL_RCC_PWR_CLK_ENABLE();
  __HAL_PWR_VOLTAGESCALING_CONFIG(PWR_REGULATOR_VOLTAGE_SCALE1);

  /** Initializes the RCC Oscillators according to the specified parameters
  * in the RCC_OscInitTypeDef structure.
  */
  RCC_OscInitStruct.OscillatorType = RCC_OSCILLATORTYPE_HSI;
  RCC_OscInitStruct.HSIState = RCC_HSI_ON;
  RCC_OscInitStruct.HSICalibrationValue = RCC_HSICALIBRATION_DEFAULT;
  RCC_OscInitStruct.PLL.PLLState = RCC_PLL_ON;
  RCC_OscInitStruct.PLL.PLLSource = RCC_PLLSOURCE_HSI;
  RCC_OscInitStruct.PLL.PLLM = 8;
  RCC_OscInitStruct.PLL.PLLN = 180;
  RCC_OscInitStruct.PLL.PLLP = RCC_PLLP_DIV2;
  RCC_OscInitStruct.PLL.PLLQ = 4;
  if (HAL_RCC_OscConfig(&RCC_OscInitStruct) != HAL_OK)
  {
    Error_Handler();
  }

  /** Activate the Over-Drive mode
  */
  if (HAL_PWREx_EnableOverDrive() != HAL_OK)
  {
    Error_Handler();
  }

  /** Initializes the CPU, AHB and APB buses clocks
  */
  RCC_ClkInitStruct.ClockType = RCC_CLOCKTYPE_HCLK|RCC_CLOCKTYPE_SYSCLK
                              |RCC_CLOCKTYPE_PCLK1|RCC_CLOCKTYPE_PCLK2;
  RCC_ClkInitStruct.SYSCLKSource = RCC_SYSCLKSOURCE_PLLCLK;
  RCC_ClkInitStruct.AHBCLKDivider = RCC_SYSCLK_DIV1;
  RCC_ClkInitStruct.APB1CLKDivider = RCC_HCLK_DIV4;
  RCC_ClkInitStruct.APB2CLKDivider = RCC_HCLK_DIV2;

  if (HAL_RCC_ClockConfig(&RCC_ClkInitStruct, FLASH_LATENCY_5) != HAL_OK)
  {
    Error_Handler();
  }
}

static void MX_GPIO_Init(void)
{
  GPIO_InitTypeDef GPIO_InitStruct = {0};

  /* GPIO Ports Clock Enable */
  __HAL_RCC_GPIOA_CLK_ENABLE();

  /*Configure GPIO pin Output Level */
  HAL_GPIO_WritePin(NeoPixel_Pin_GPIO_Port, NeoPixel_Pin_Pin, GPIO_PIN_RESET);

  /*Configure GPIO pin : NeoPixel_Pin_Pin */
  GPIO_InitStruct.Pin = NeoPixel_Pin_Pin;
  GPIO_InitStruct.Mode = GPIO_MODE_OUTPUT_PP;
  GPIO_InitStruct.Pull = GPIO_NOPULL;
  GPIO_InitStruct.Speed = GPIO_SPEED_FREQ_LOW;
  HAL_GPIO_Init(NeoPixel_Pin_GPIO_Port, &GPIO_InitStruct);

}

void Error_Handler(void)
{
  __disable_irq();
  while (1)
  {
  }
}
