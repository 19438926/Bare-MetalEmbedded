# file: WS2812B.ioc
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Mcu.Family=STM32F0
Mcu.Name=STM32F030C8Tx
Mcu.Package=LQFP48
PA7.GPIO_Label=NeoPixel
PA7.Signal=GPIO_Output
ProjectManager.HeapSize=0x200
ProjectManager.StackSize=0x400
ProjectManager.TargetToolchain=STM32CubeIDE
RCC.AHBFreq_Value=48000000
RCC.APB1Freq_Value=48000000
RCC.APB1TimFreq_Value=48000000
RCC.HCLKFreq_Value=48000000
RCC.PLLMUL=RCC_PLL_MUL12
RCC.SYSCLKFreq_VALUE=48000000
RCC.SYSCLKSource=RCC_SYSCLKSOURCE_PLLCLK
board=custom

// file: Core/Src/main.c
/* USER CODE BEGIN Header */
/**
  ******************************************************************************
  * @file           : main.c
  * @brief          : Main program body
  ******************************************************************************
  * @attention
  *
  * Copyright (c) 2026 STMicroelectronics.
  * All rights reserved.
  *
  * This software is licensed under terms that can be found in the LICENSE file
  * in the root directory of this software component.
  * If no LICENSE file comes with this software, it is provided AS-IS.
  *
  ******************************************************************************
  */
/* USER CODE END Header */
#include "main.h"

/* USER CODE BEGIN Includes */
#include "NeoPixel.h"

/* USER CODE END Includes */

/* USER CODE BEGIN PV */
// Color structures
const WS2812_LED LED_COLOR_BLACK    = RGB_COLOR_BLACK;
const WS2812_LED LED_COLOR_GRAY     = RGB_COLOR_GRAY;
const WS2812_LED LED_COLOR_WHITE    = RGB_COLOR_WHITE;
const WS2812_LED LED_COLOR_RED      = RGB_COLOR_RED;
const WS2812_LED LED_COLOR_GREEN    = RGB_COLOR_GREEN;
const WS2812_LED LED_COLOR_BLUE     = RGB_COLOR_BLUE;
const WS2812_LED LED_COLOR_ORANGE   = RGB_COLOR_ORANGE;
const WS2812_LED LED_COLOR_YELLOW   = RGB_COLOR_YELLOW;
const WS2812_LED LED_COLOR_VIOLET   = RGB_COLOR_VIOLET;
const WS2812_LED LED_COLOR_INDIGO   = RGB_COLOR_INDIGO;
const WS2812_LED LED_COLOR_CYAN     = RGB_COLOR_CYAN;
const WS2812_LED LED_COLOR_MAGENTA  = RGB_COLOR_MAGENTA;
const WS2812_LED LED_COLOR_AQUA     = RGB_COLOR_AQUA;

WS2812_LED logicLEDS[6] = {
                                     LED_COLOR_WHITE,
                                     LED_COLOR_WHITE,
                                     LED_COLOR_WHITE,
                                     LED_COLOR_BLACK,
                                     LED_COLOR_WHITE,
                                     LED_COLOR_WHITE
                                   };
WS2812_LED logicLEDS2[6] = {
                                     LED_COLOR_GREEN,
									 LED_COLOR_BLACK,
									 LED_COLOR_BLACK,
									 LED_COLOR_BLACK,
									 LED_COLOR_BLACK,
									 LED_COLOR_BLACK
                                   };

/* USER CODE END PV */

void SystemClock_Config(void);
static void MX_GPIO_Init(void);

int main(void)
{

  /* MCU Configuration--------------------------------------------------------*/

  /* Reset of all peripherals, Initializes the Flash interface and the Systick. */
  HAL_Init();

  /* Configure the system clock */
  SystemClock_Config();

  /* Initialize all configured peripherals */
  MX_GPIO_Init();

  /* Infinite loop */
  while (1)
  {

    /* USER CODE BEGIN 3 */
	 WS2812_WriteLeds(logicLEDS, 6);
	 //HAL_Delay(1);
	 WS2812_Reset();

//	  GPIOA->ODR ^= GPIO_ODR_7;
//	  asm volatile ("nop\nnop\nnop\nnop\nnop\nnop\nnop\nnop\n");

  }
  /* USER CODE END 3 */
}

void SystemClock_Config(void)
{
  RCC_OscInitTypeDef RCC_OscInitStruct = {0};
  RCC_ClkInitTypeDef RCC_ClkInitStruct = {0};

  /** Initializes the RCC Oscillators according to the specified parameters
  * in the RCC_OscInitTypeDef structure.
  */
  RCC_OscInitStruct.OscillatorType = RCC_OSCILLATORTYPE_HSI;
  RCC_OscInitStruct.HSIState = RCC_HSI_ON;
  RCC_OscInitStruct.HSICalibrationValue = RCC_HSICALIBRATION_DEFAULT;
  RCC_OscInitStruct.PLL.PLLState = RCC_PLL_ON;
  RCC_OscInitStruct.PLL.PLLSource = RCC_PLLSOURCE_HSI;
  RCC_OscInitStruct.PLL.PLLMUL = RCC_PLL_MUL12;
  RCC_OscInitStruct.PLL.PREDIV = RCC_PREDIV_DIV1;
  if (HAL_RCC_OscConfig(&RCC_OscInitStruct) != HAL_OK)
  {
    Error_Handler();
  }

  /** Initializes the CPU, AHB and APB buses clocks
  */
  RCC_ClkInitStruct.ClockType = RCC_CLOCKTYPE_HCLK|RCC_CLOCKTYPE_SYSCLK
                              |RCC_CLOCKTYPE_PCLK1;
  RCC_ClkInitStruct.SYSCLKSource = RCC_SYSCLKSOURCE_PLLCLK;
  RCC_ClkInitStruct.AHBCLKDivider = RCC_SYSCLK_DIV1;
  RCC_ClkInitStruct.APB1CLKDivider = RCC_HCLK_DIV1;

  if (HAL_RCC_ClockConfig(&RCC_ClkInitStruct, FLASH_LATENCY_1) != HAL_OK)
  {
    Error_Handler();
  }
}

static void MX_GPIO_Init(void)
{
  GPIO_InitTypeDef GPIO_InitStruct = {0};

  /* GPIO Ports Clock Enable */
  __HAL_RCC_GPIOA_CLK_ENABLE();

  /*Configure GPIO pin Output Level */
  HAL_GPIO_WritePin(NeoPixel_GPIO_Port, NeoPixel_Pin, GPIO_PIN_RESET);

  /*Configure GPIO pin : NeoPixel_Pin */
  GPIO_InitStruct.Pin = NeoPixel_Pin;
  GPIO_InitStruct.Mode = GPIO_MODE_OUTPUT_PP;
  GPIO_InitStruct.Pull = GPIO_NOPULL;
  GPIO_InitStruct.Speed = GPIO_SPEED_FREQ_LOW;
  HAL_GPIO_Init(NeoPixel_GPIO_Port, &GPIO_InitStruct);

}

void Error_Handler(void)
{
  __disable_irq();
  while (1)
  {
  }
}
